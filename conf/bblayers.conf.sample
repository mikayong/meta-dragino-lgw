## conf/bblayers.conf.sample
```bitbake
# POKY_BBLAYERS_CONF_VERSION is increased each time build/conf/bblayers.conf
# changes incompatibly
POKY_BBLAYERS_CONF_VERSION = "2"

BBPATH = "${TOPDIR}"
BBFILES ?= ""

VENDOR = "dragino"

BBLAYERS ?= " \
  ##OEROOT##/metas/openembedded-core/meta \
  ##OEROOT##/metas/meta-openembedded/meta-networking \
  ##OEROOT##/metas/meta-openembedded/meta-filesystems \
  ##OEROOT##/metas/meta-openembedded/meta-oe \
  ##OEROOT##/metas/meta-openembedded/meta-python \
  ##OEROOT##/metas/mender/meta-mender-core \
  ##OEROOT##/metas/meta-dragino-lgw/meta-dragino-basic \
  ##OEROOT##/metas/meta-dragino-lgw/meta-dragino-pg308 \
  ##OEROOT##/metas/meta-raspberrypi \
  "
```

## conf/distro/dragino-gw-os.conf
```bitbake
DISTRO = "dragino-gw-os"
DISTRO_NAME = "DRAGINO LoRa Gateway OS"
DISTRO_VERSION = "1.0.0test2"

PACKAGE_CLASSES = "package_ipk"
IMAGE_INSTALL_append = " opkg "
EXTRA_IMAGE_FEATURES += "package-management ssh-server-dropbear"
```

## conf/distro/dragino-lgw-os.conf
```bitbake
DISTRO = "dragino-lgw-os"
DISTRO_NAME = "DRAGINO LoRa Gateway OS"
DISTRO_VERSION = "1.0.0"

PACKAGE_CLASSES = "package_ipk"
IMAGE_INSTALL_append = " opkg "
EXTRA_IMAGE_FEATURES += "package-management ssh-server-dropbear"
```

## conf/layer.conf
```bitbake
# We have a conf and classes directory, add to BBPATH
BBPATH .= ":${LAYERDIR}"

# We have recipes-* directories, add to BBFILES
BBFILES += "${LAYERDIR}/recipes-*/*/*.bb \
	${LAYERDIR}/recipes-*/*/*.bbappend"

BBFILE_COLLECTIONS += "dragino-lgw"

BBFILE_PATTERN_dragino-lgw = "^${LAYERDIR}/"
LAYERSERIES_COMPAT_dragino-lgw = "warrior"

# Mender configuration
MENDER_ARTIFACT_NAME ?= "dragino-lgw-os-${DISTRO_VERSION}"

# Set image overhead to 1
IMAGE_OVERHEAD_FACTOR = "1"
```
